#include "dac.h"

#include <stdbool.h>
#include <stdint.h>
#include "inc/hw_gpio.h"
#include "inc/hw_memmap.h"
#include "inc/hw_types.h"
#include "driverlib/gpio.h"
#include "driverlib/epi.h"
#include "driverlib/rom_map.h"
#include "driverlib/sysctl.h"
#include "driverlib/timer.h"
#include "driverlib/rom.h"
#include "inc/tm4c1294ncpdt.h"
#include "utils/uartstdio.h"

const float sin_data[256]={/*256点正弦查找表*/
  0.00000,0.02464,0.04926,0.07385,0.09840,0.12289,0.14730,0.17163,0.19585,0.21995,0.24391,
  0.26773,0.29139,0.31487,0.33816,0.36124,0.38411,0.40674,0.42912,0.45124,0.47309,0.49466,
  0.51592,0.53687,0.55749,0.57777,0.59771,0.61728,0.63647,0.65528,0.67370,0.69170,0.70928,
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  -0.09840,-0.07385,-0.04926,-0.02464,-0.00000};      
 
void DAC_Init()
{
	//CS  ~ PE1  
	//WR  ~ PE2
	SysCtlPeripheralEnable(SYSCTL_PERIPH_GPIOE);
	SysCtlGPIOAHBEnable(SYSCTL_PERIPH_GPIOE);
	GPIOPinTypeGPIOOutput(GPIO_PORTE_BASE, GPIO_PIN_1|GPIO_PIN_2);
	
	/*
		DATA0  ~ PK3
		DATA1  ~ PK2
		DATA2  ~ PK1
		DATA3  ~ PK0
		DATA4  ~ PC7
		DATA5  ~ PC6
		DATA6  ~ PC5
		DATA7  ~ PC4
		DATA8  ~ PA6
		DATA9  ~ PA7
		DATA10 ~ PG1
		DATA11 ~ PG0
	*/
	
	SysCtlPeripheralEnable(SYSCTL_PERIPH_GPIOK);
	SysCtlGPIOAHBEnable(SYSCTL_PERIPH_GPIOK);
	GPIOPinTypeGPIOOutput(GPIO_PORTK_BASE, GPIO_PIN_3|GPIO_PIN_2|GPIO_PIN_1|GPIO_PIN_0);
	
	SysCtlPeripheralEnable(SYSCTL_PERIPH_GPIOC);
	SysCtlGPIOAHBEnable(SYSCTL_PERIPH_GPIOC);
	GPIOPinTypeGPIOOutput(GPIO_PORTC_BASE, GPIO_PIN_7|GPIO_PIN_6|GPIO_PIN_5|GPIO_PIN_4);
	
	SysCtlPeripheralEnable(SYSCTL_PERIPH_GPIOA);
	SysCtlGPIOAHBEnable(SYSCTL_PERIPH_GPIOA);
	GPIOPinTypeGPIOOutput(GPIO_PORTA_BASE, GPIO_PIN_6|GPIO_PIN_7);
	
	SysCtlPeripheralEnable(SYSCTL_PERIPH_GPIOG);
	SysCtlGPIOAHBEnable(SYSCTL_PERIPH_GPIOG);
	GPIOPinTypeGPIOOutput(GPIO_PORTG_BASE, GPIO_PIN_1|GPIO_PIN_0);
	
}

void DAC_Set_Data(uint16_t out)
{
	bool out_buffer[12];
	uint16_t temp;
	for(int i=0;i<12;i++)
	{
		out_buffer[i] = (out<<(4+i))>>15;
	}
	
	GPIOPinWrite(GPIO_PORTG_BASE, GPIO_PIN_0, out_buffer[0]?GPIO_PIN_0:0);  //DATA11
	GPIOPinWrite(GPIO_PORTG_BASE, GPIO_PIN_1, out_buffer[1]?GPIO_PIN_1:0);  //DATA10
	GPIOPinWrite(GPIO_PORTA_BASE, GPIO_PIN_7, out_buffer[2]?GPIO_PIN_7:0);  //DATA9
	GPIOPinWrite(GPIO_PORTA_BASE, GPIO_PIN_6, out_buffer[3]?GPIO_PIN_6:0);  //DATA8
	GPIOPinWrite(GPIO_PORTC_BASE, GPIO_PIN_4, out_buffer[4]?GPIO_PIN_4:0);  //DATA7
	GPIOPinWrite(GPIO_PORTC_BASE, GPIO_PIN_5, out_buffer[5]?GPIO_PIN_5:0);  //DATA6
	GPIOPinWrite(GPIO_PORTC_BASE, GPIO_PIN_6, out_buffer[6]?GPIO_PIN_6:0);  //DATA5
	GPIOPinWrite(GPIO_PORTC_BASE, GPIO_PIN_7, out_buffer[7]?GPIO_PIN_7:0);  //DATA4
	GPIOPinWrite(GPIO_PORTK_BASE, GPIO_PIN_0, out_buffer[8]?GPIO_PIN_0:0);  //DATA3
	GPIOPinWrite(GPIO_PORTK_BASE, GPIO_PIN_1, out_buffer[9]?GPIO_PIN_1:0);  //DATA2
	GPIOPinWrite(GPIO_PORTK_BASE, GPIO_PIN_2, out_buffer[10]?GPIO_PIN_2:0);  //DATA1
	GPIOPinWrite(GPIO_PORTK_BASE, GPIO_PIN_3, out_buffer[11]?GPIO_PIN_3:0);  //DATA0
}

//out = 3.3*out/4096 (0<out<4096)
void DAC_Output(uint16_t out)
{
	//PULL UP CS
	GPIOPinWrite(GPIO_PORTE_BASE, GPIO_PIN_1, GPIO_PIN_1);
	SysCtlDelay(1);
	
	//PULL DOWN WR
	GPIOPinWrite(GPIO_PORTE_BASE, GPIO_PIN_2, 0);
	SysCtlDelay(1);
	
	//PULL DOWN CS
	GPIOPinWrite(GPIO_PORTE_BASE, GPIO_PIN_1, 0);
	SysCtlDelay(1);
	
	//SET DATA0~11
	DAC_Set_Data(out);
	SysCtlDelay(1);
	
	//PULL UP CS
	GPIOPinWrite(GPIO_PORTE_BASE, GPIO_PIN_1, GPIO_PIN_1);
	SysCtlDelay(1);
	
	//PULL up WR
	GPIOPinWrite(GPIO_PORTE_BASE, GPIO_PIN_2, GPIO_PIN_2);
	SysCtlDelay(1);
}

void DAC_Test()
{
	uint16_t i =0;
	uint16_t temp;
	for(;;)
	{
		temp = (uint16_t)(4095.0*(sin_data[i++]+1.0)/2.0);
		UARTprintf("%4d\n",temp);
		DAC_Output(temp);
		if(i==256)i=0;
		SysCtlDelay(100*SysCtlClockGet()/3000);
	}
}
